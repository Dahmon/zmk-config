## config/west.yml
```yaml
manifest:
  remotes:
    - name: zmkfirmware
      url-base: https://github.com/zmkfirmware
    - name: munnich
      url-base: https://github.com/nmunnich
  projects:
    - name: zmk
      remote: zmkfirmware
      revision: main
      import: app/west.yml
    - name: zmk-apiaster-module
      remote: munnich
      revision: main
      import: app/west.yml
  self:
    path: config
```
